/dts-v1/;
/plugin/;

/ {
    compatible = "zmk,keyboard-shield";

    chosen { zmk,kscan = &kscan0; };

    kscan0: kscan {
        compatible = "zmk,kscan-gpio-matrix";
        diode-direction = "col2row";

        /* Same 7 columns as left */
        col-gpios = <&gpio0 17 GPIO_ACTIVE_LOW
                     &gpio0 20 GPIO_ACTIVE_LOW
                     &gpio0 22 GPIO_ACTIVE_LOW
                     &gpio0 24 GPIO_ACTIVE_LOW
                     &gpio1 0  GPIO_ACTIVE_LOW
                     &gpio0 11 GPIO_ACTIVE_LOW
                     &gpio1 4  GPIO_ACTIVE_LOW>;

        row-gpios = <&gpio1 6 GPIO_ACTIVE_LOW
                     &gpio0 31 GPIO_ACTIVE_LOW
                     &gpio0 29 GPIO_ACTIVE_LOW
                     &gpio0 2  GPIO_ACTIVE_LOW>;
    };

    encoder0: encoder {
        compatible = "gpio-encoder";
        a-gpios = <&gpio0 6 GPIO_ACTIVE_HIGH>;  /* D1 / P0.06 */
        b-gpios = <&gpio0 8 GPIO_ACTIVE_HIGH>;  /* D0 / P0.08 */
        steps-per-period = <4>;
        status = "okay";
    };
};
