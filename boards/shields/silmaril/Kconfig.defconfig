## boards/shields/silmaril/Kconfig.defconfig
```kconfig
if SHIELD_SILMARIL_LEFT

config ZMK_KEYBOARD_NAME
    default "Silmaril"

config ZMK_SPLIT_ROLE_CENTRAL
    default y

endif

if SHIELD_SILMARIL_LEFT || SHIELD_SILMARIL_RIGHT

config ZMK_SPLIT
    default y
endif
```

## boards/shields/telperion/Kconfig.defconfig
```kconfig
if SHIELD_TELPERION_LEFT
    config ZMK_KEYBOARD_NAME
        default "Telperion"

    config ZMK_SPLIT_ROLE_CENTRAL
        default y
endif

if SHIELD_TELPERION_LEFT || SHIELD_TELPERION_RIGHT
    config ZMK_SPLIT
        default y

    if SHIELD_TELPERION_RIGHT
        config ZMK_SPLIT_ROLE_PERIPHERAL
            bool "Peripheral role"
            default y
    else
        config ZMK_SPLIT_ROLE_PERIPHERAL
            bool "Peripheral role"
            default n
    endif
endif
```

## boards/shields/telperion/Kconfig.shield
```kconfig
config SHIELD_TELPERION_LEFT
    def_bool $(shields_list_contains, telperion_left)

config SHIELD_TELPERION_RIGHT
    def_bool $(shields_list_contains, telperion_right)
```

## config/boards/shields/silmaril/Kconfig.shield
```kconfig
config SHIELD_SILMARIL_LEFT
    def_bool $(shields_list_contains, silmaril_left)

config SHIELD_CORNE_RIGHT
    def_bool $(shields_list_contains, silmaril_right)
```
