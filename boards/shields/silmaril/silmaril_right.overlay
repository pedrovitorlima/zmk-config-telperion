#include "silmaril.dtsi"

&default_transform {
    col-offset = <7>;  /* start after left 7 columns */
};

&kscan0 {
    col-gpios = <&gpio0 17 GPIO_ACTIVE_HIGH>, // D2 / P0.17 - col1
                <&gpio0 20 GPIO_ACTIVE_HIGH>, // D3 / P0.20 - col2
                <&gpio0 22 GPIO_ACTIVE_HIGH>, // D4 / P0.22 - col3
                <&gpio0 24 GPIO_ACTIVE_HIGH>, // D5 / P0.24 - col4
                <&gpio1 0  GPIO_ACTIVE_HIGH>, // D6 / P1.00 - col5
                <&gpio0 11 GPIO_ACTIVE_HIGH>, // D7 / P0.11 - col6
                <&gpio1 4  GPIO_ACTIVE_HIGH>; // D8 / P1.04 - col7

    rotary_encoder: rotary_encoder {
        compatible = "zmk,rotary-encoder";
        encoder-gpios = <&gpio0 6 GPIO_ACTIVE_HIGH>, // D1 / P0.06 - Encoder A
                        <&gpio0 8 GPIO_ACTIVE_HIGH>; // D0 / P0.08 - Encoder B

    };
};
