#include "telperion.dtsi"

&default_transform {
    col-offset = <7>;  /* start after left 7 columns */
};

  
&kscan0 {
    col-gpios = <&xiao_d 2 GPIO_ACTIVE_HIGH>,  // D2 / P0.17 - col1
                <&xiao_d 3 GPIO_ACTIVE_HIGH>,  // D3 / P0.20 - col2
                <&xiao_d 4 GPIO_ACTIVE_HIGH>,  // D4 / P0.22 - col3
                <&xiao_d 5 GPIO_ACTIVE_HIGH>,  // D5 / P0.24 - col4
                <&xiao_d 6 GPIO_ACTIVE_HIGH>, // D6 / P1.00 - col5
                <&xiao_d 7 GPIO_ACTIVE_HIGH>,  // D7 / P0.11 - col6
                <&xiao_d 8 GPIO_ACTIVE_HIGH>; // D8 / P1.04 - col7

};

