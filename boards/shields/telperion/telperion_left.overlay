#include "telperion.dtsi"

&kscan0 {
    col-gpios = <&pro_micro 2 GPIO_ACTIVE_HIGH>,  
                <&pro_micro 3 GPIO_ACTIVE_HIGH>,  
                <&pro_micro 4 GPIO_ACTIVE_HIGH>,  
                <&pro_micro 5 GPIO_ACTIVE_HIGH>,  
                <&pro_micro 6 GPIO_ACTIVE_HIGH>, 
                <&pro_micro 7 GPIO_ACTIVE_HIGH>, 
                <&pro_micro 8 GPIO_ACTIVE_HIGH>; 

};

sensors: sensors {
    compatible = "zmk,keymap-sensors";
    sensors = <&left_encoder>;
    triggers-per-rotation = <20>;
};

&left_encoder {
    status = "okay";
};